/ {
  chosen {
    zmk,kscan = &kscan0;
  };

  kscan0: kscan {
    compatible = "zmk,kscan-gpio-matrix";
    diode-direction = "col2row";

    row-gpios = <&gpio0 31 GPIO_ACTIVE_LOW>,
                <&gpio0 29 GPIO_ACTIVE_LOW>,
                <&gpio0 2  GPIO_ACTIVE_LOW>,
                <&gpio0 15 GPIO_ACTIVE_LOW>,
                <&gpio0 13 GPIO_ACTIVE_LOW>,
                <&gpio0 11 GPIO_ACTIVE_LOW>;

    col-gpios = <&gpio0 10 GPIO_ACTIVE_LOW>,
                <&gpio0 9  GPIO_ACTIVE_LOW>,
                <&gpio0 6  GPIO_ACTIVE_LOW>,
                <&gpio0 4  GPIO_ACTIVE_LOW>;
  };
};
